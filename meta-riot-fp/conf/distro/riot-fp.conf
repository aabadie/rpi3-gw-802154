## meta-riot-fp/conf/distro/riot-fp.conf
```bitbake
require conf/distro/poky.conf      

DISTRO          = "riot-fp"
DISTRO_NAME     = "RIOT-FP 802154 GW"
DISTRO_VERSION  = "2019-devel"
DISTRO_REVISION = "1"
DISTRO_PR       = ".1"
DISTRO_TYPE     = "dev"

DEFAULT_TIMEZONE ?= "Europe/Paris"

DISTRO_FEATURES_append = " systemd ipv6 bluetooth wifi"
DISTRO_FEATURES_BACKFILL_CONSIDERED += "sysvinit"
VIRTUAL-RUNTIME_init_manager = "systemd"
VIRTUAL-RUNTIME_initscripts = "systemd-compat-units"

PACKAGECONFIG_append_pn-systemd = " resolved"
```

## meta-riot-fp/conf/layer.conf
```bitbake
# We have a conf and classes directory, add to BBPATH
BBPATH .= ":${LAYERDIR}"

# We have a recipes-* directories, add to BBFILES
BBFILES += "${LAYERDIR}/recipes-*/*/*.bb ${LAYERDIR}/recipes-*/*/*.bbappend"

BBFILE_COLLECTIONS += "riot-fp"
BBFILE_PATTERN_riot-fp = "^${LAYERDIR}"

LAYERSERIES_COMPAT_riot-fp = "thud"
```
